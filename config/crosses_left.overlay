#include <zephyr/dt-bindings/input/input-event-codes.h>
#include <dt-bindings/zmk/input_transform.h>

&trackball_peripheral {
    cpi = <100>;
    x-invert;
    /delete-property/ y-invert;
};

&trackball_peripheral_split {
    input-processors = <
        &zip_ble_report_rate_limit
    >;
};
