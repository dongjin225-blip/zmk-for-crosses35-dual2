## Kconfig
```kconfig
config CROSSES_INPUT_PROCESSOR_ROTATE
    bool "Crosses custom input processor for small trackball rotation"
    depends on ZMK_POINTING
```

## config/west.yml
```yaml
manifest:
  defaults:
    revision: main

  remotes:
    - name: zmkfirmware
      url-base: https://github.com/zmkfirmware
    - name: Good-Great-Grand-Wonderful
      url-base: https://github.com/Good-Great-Grand-Wonderful
    - name: HeeTuic
      url-base: https://github.com/HeeTuic
    - name: cormoran
      url-base: https://github.com/cormoran

  projects:
    - name: zmk
      remote: zmkfirmware
      revision: ac7f75b8591d39aaf3b66b9d26f26c9ed921a009
      import: app/west.yml

    - name: cb-zmk-keebs
      remote: HeeTuic
      revision: zephyr-4.1
      import: config/west.yml

    # 15도 같은 미세 각도 회전 보정용 input processor 모듈.
    - name: zmk-module-runtime-input-processor
      remote: cormoran
      revision: main

    # runtime input processor가 설정 저장 백엔드로 요구하는 모듈.
    - name: zmk-feature-custom-settings
      remote: cormoran
      revision: main

  self:
    path: config
```

## dts/bindings/input_processors/crosses,input-processor-rotate.yaml
```yaml
# Copyright (c) 2026
# SPDX-License-Identifier: MIT

description: Small-angle XY rotation processor for Crosses trackballs

compatible: "crosses,input-processor-rotate"

include: ip_zero_param.yaml

properties:
  cos-milli:
    type: int
    required: true
    description: Cosine of the correction angle multiplied by 1000.

  sin-milli:
    type: int
    required: true
    description: Sine of the correction angle multiplied by 1000.
```

## dts/bindings/input_processors/zmk,input-processor-rotate.yaml
```yaml
# Copyright (c) 2026
# SPDX-License-Identifier: MIT

description: Small-angle XY rotation processor for Crosses trackballs

compatible: "zmk,input-processor-rotate"

properties:
  "#input-processor-cells":
    type: int
    required: true
    const: 0

  cos-milli:
    type: int
    required: true
    description: Cosine of the correction angle multiplied by 1000.

  sin-milli:
    type: int
    required: true
    description: Sine of the correction angle multiplied by 1000.
```
